## CMakeLists.txt
```
cmake_minimum_required(VERSION 3.20.0)

find_package(Zephyr REQUIRED HINTS $ENV{ZEPHYR_BASE})
project(led_studio_controller)

target_include_directories(app PRIVATE include)
target_sources(
  app
  PRIVATE
    src/controller_runtime.c
    src/main.c
)
```

## prj.conf
```kconfig
CONFIG_GPIO=y
CONFIG_LED_STRIP=y
CONFIG_LOG=y
CONFIG_MAIN_STACK_SIZE=2048
CONFIG_WS2812_STRIP_GPIO=y
```

## boards/xiao_ble_nrf52840.overlay
```dts
#include <zephyr/dt-bindings/gpio/gpio.h>
#include <zephyr/dt-bindings/led/led.h>

/ {
  chosen {
    zephyr,led-strip = &bass_leds;
  };

  bass_leds: ws2812 {
    compatible = "worldsemi,ws2812-gpio";
    chain-length = <10>;
    color-mapping = <LED_COLOR_ID_GREEN LED_COLOR_ID_RED LED_COLOR_ID_BLUE>;
    gpios = <&xiao_d 0 GPIO_ACTIVE_HIGH>;
    reset-delay = <300>;
  };
};
```

## src/main.c
```c
#include <led_studio/controller_runtime.h>

#include <stddef.h>
#include <stdint.h>

#include <zephyr/device.h>
#include <zephyr/devicetree.h>
#include <zephyr/drivers/led_strip.h>
#include <zephyr/kernel.h>
#include <zephyr/logging/log.h>
#include <zephyr/sys/util.h>

LOG_MODULE_REGISTER(led_studio_controller, LOG_LEVEL_INF);

#define LED_STRIP_NODE DT_CHOSEN(zephyr_led_strip)
#define STARTUP_WALK_STEP_US 200000ULL
#define STARTUP_WALK_DURATION_US                                            \
  (STARTUP_WALK_STEP_US * (uint64_t)LED_STUDIO_LED_COUNT)
#define STARTUP_PRIMARY_DURATION_US 500000ULL
#define STARTUP_TEST_DURATION_US                                            \
  (STARTUP_WALK_DURATION_US + 3ULL * STARTUP_PRIMARY_DURATION_US)
#define RENDER_INTERVAL_US (1000000ULL / LED_STUDIO_RENDER_HZ)

static const struct device *const led_strip = DEVICE_DT_GET(LED_STRIP_NODE);

static const led_studio_frame_t marker_glow_frame = {
    .pixels =
        {
            {0U, 255U, 64U},
            {0U, 255U, 64U},
            {0U, 255U, 64U},
            {0U, 255U, 64U},
            {255U, 43U, 154U},
            {255U, 43U, 154U},
            {0U, 255U, 64U},
            {0U, 255U, 64U},
            {0U, 255U, 64U},
            {0U, 255U, 64U},
        },
};

static const led_studio_frame_t pink_hold_frame = {
    .pixels =
        {
            {255U, 43U, 154U},
            {255U, 43U, 154U},
            {255U, 43U, 154U},
            {255U, 43U, 154U},
            {255U, 43U, 154U},
            {255U, 43U, 154U},
            {255U, 43U, 154U},
            {255U, 43U, 154U},
            {255U, 43U, 154U},
            {255U, 43U, 154U},
        },
};

static const led_studio_scene_t demo_scenes[] = {
    {
        .loop_length_q16 = 4U * LED_STUDIO_BEAT_ONE_Q16,
        .frame = &marker_glow_frame,
    },
    {
        .loop_length_q16 = 4U * LED_STUDIO_BEAT_ONE_Q16,
        .frame = &pink_hold_frame,
    },
};

static const led_studio_cue_t demo_cues[] = {
    {
        .scene_index = 0U,
        .advance = LED_STUDIO_CUE_AFTER_LOOPS,
        .loop_count = 2U,
    },
    {
        .scene_index = 1U,
        .advance = LED_STUDIO_CUE_MANUAL,
        .loop_count = 0U,
    },
};

static const led_studio_song_t demo_song = {
    .beats_per_minute = 120U,
    .cue_count = 2U,
    .cues = demo_cues,
};

static uint64_t monotonic_microseconds(void) {
  return k_ticks_to_us_floor64(k_uptime_ticks());
}

static void render_startup_test(uint64_t elapsed_us,
                                led_studio_frame_t *frame) {
  size_t index;

  *frame = (led_studio_frame_t){0};
  if (elapsed_us < STARTUP_WALK_DURATION_US) {
    const size_t address = (size_t)(elapsed_us / STARTUP_WALK_STEP_US);
    frame->pixels[address] = (led_studio_rgb_t){255U, 255U, 255U};
    return;
  }

  index = (size_t)((elapsed_us - STARTUP_WALK_DURATION_US) /
                   STARTUP_PRIMARY_DURATION_US);
  if (index == 0U) {
    for (index = 0U; index < LED_STUDIO_LED_COUNT; index += 1U) {
      frame->pixels[index].red = 255U;
    }
  } else if (index == 1U) {
    for (index = 0U; index < LED_STUDIO_LED_COUNT; index += 1U) {
      frame->pixels[index].green = 255U;
    }
  } else {
    for (index = 0U; index < LED_STUDIO_LED_COUNT; index += 1U) {
      frame->pixels[index].blue = 255U;
    }
  }
}

static int write_frame(const led_studio_frame_t *frame) {
  struct led_rgb pixels[LED_STUDIO_LED_COUNT] = {0};
  size_t index;

  for (index = 0U; index < LED_STUDIO_LED_COUNT; index += 1U) {
    pixels[index].r = frame->pixels[index].red;
    pixels[index].g = frame->pixels[index].green;
    pixels[index].b = frame->pixels[index].blue;
  }
  return led_strip_update_rgb(led_strip, pixels, LED_STUDIO_LED_COUNT);
}

int main(void) {
  led_studio_transport_t transport;
  led_studio_frame_t scene_frame;
  led_studio_frame_t output_frame;
  uint64_t previous_us;
  uint64_t next_render_us;
  uint64_t started_us;
  bool demo_started = false;

  if (!device_is_ready(led_strip)) {
    LOG_ERR("LED strip device is not ready");
    return 0;
  }
  if (led_strip_length(led_strip) < LED_STUDIO_LED_COUNT) {
    LOG_ERR("LED strip exposes fewer than %u pixels", LED_STUDIO_LED_COUNT);
    return 0;
  }
  if (!led_studio_transport_init(&transport, demo_scenes,
                                 ARRAY_SIZE(demo_scenes), &demo_song)) {
    LOG_ERR("Built-in demo song is invalid");
    return 0;
  }

  started_us = monotonic_microseconds();
  previous_us = started_us;
  next_render_us = started_us;
  LOG_INF("Starting 10-address walk and RGB calibration at %u%% brightness",
          LED_STUDIO_BRIGHTNESS_LIMIT_PERCENT);

  while (true) {
    const uint64_t now_us = monotonic_microseconds();
    const uint64_t startup_elapsed_us = now_us - started_us;

    if (!demo_started && startup_elapsed_us >= STARTUP_TEST_DURATION_US) {
      demo_started = true;
      previous_us = now_us;
      LOG_INF("Starting built-in two-scene song at %u BPM",
              (unsigned int)demo_song.beats_per_minute);
    }
    if (demo_started) {
      if (!led_studio_transport_advance_us(&transport,
                                           now_us - previous_us)) {
        LOG_ERR("Transport could not advance");
        break;
      }
      previous_us = now_us;
    }

    if (now_us >= next_render_us) {
      if (demo_started) {
        led_studio_transport_render(&transport, &scene_frame);
      } else {
        render_startup_test(startup_elapsed_us, &scene_frame);
      }
      led_studio_apply_brightness_limit(
          &scene_frame, &output_frame,
          LED_STUDIO_BRIGHTNESS_LIMIT_PERCENT);
      if (write_frame(&output_frame) != 0) {
        LOG_ERR("LED strip update failed");
        break;
      }
      next_render_us += RENDER_INTERVAL_US;
      if (next_render_us <= now_us) {
        next_render_us = now_us + RENDER_INTERVAL_US;
      }
    }

    k_sleep(K_MSEC(1));
  }

  return 0;
}
```

## src/controller_runtime.c
```c
#include <led_studio/controller_runtime.h>

#include <limits.h>
#include <string.h>

#define MICROSECONDS_PER_MINUTE 60000000ULL

static bool song_is_valid(const led_studio_scene_t *scenes,
                          size_t scene_count,
                          const led_studio_song_t *song) {
  size_t index;

  if (scenes == NULL || scene_count == 0U || song == NULL ||
      song->cues == NULL || song->cue_count == 0U ||
      song->beats_per_minute == 0U) {
    return false;
  }

  for (index = 0U; index < scene_count; index += 1U) {
    if (scenes[index].frame == NULL || scenes[index].loop_length_q16 == 0U) {
      return false;
    }
  }

  for (index = 0U; index < song->cue_count; index += 1U) {
    const led_studio_cue_t *cue = &song->cues[index];
    if (cue->scene_index >= scene_count) {
      return false;
    }
    if (cue->advance == LED_STUDIO_CUE_AFTER_LOOPS && cue->loop_count == 0U) {
      return false;
    }
    if (cue->advance != LED_STUDIO_CUE_MANUAL &&
        cue->advance != LED_STUDIO_CUE_AFTER_LOOPS) {
      return false;
    }
  }

  return true;
}

static void reset_cue_position(led_studio_transport_t *transport,
                               uint16_t cue_index) {
  transport->active_cue_index = cue_index;
  transport->completed_loops = 0U;
  transport->cue_position_q16 = 0U;
  transport->final_cue_held = false;
}

bool led_studio_transport_init(led_studio_transport_t *transport,
                               const led_studio_scene_t *scenes,
                               size_t scene_count,
                               const led_studio_song_t *song) {
  if (transport == NULL) {
    return false;
  }

  memset(transport, 0, sizeof(*transport));
  if (!song_is_valid(scenes, scene_count, song)) {
    return false;
  }

  transport->scenes = scenes;
  transport->scene_count = scene_count;
  transport->song = song;
  transport->valid = true;
  reset_cue_position(transport, 0U);
  return true;
}

bool led_studio_transport_launch_cue(led_studio_transport_t *transport,
                                    uint16_t cue_index) {
  if (transport == NULL || !transport->valid ||
      cue_index >= transport->song->cue_count) {
    return false;
  }

  reset_cue_position(transport, cue_index);
  transport->beat_fraction_remainder = 0U;
  return true;
}

bool led_studio_transport_next_cue(led_studio_transport_t *transport) {
  if (transport == NULL || !transport->valid ||
      transport->active_cue_index + 1U >= transport->song->cue_count) {
    return false;
  }

  return led_studio_transport_launch_cue(
      transport, (uint16_t)(transport->active_cue_index + 1U));
}

bool led_studio_transport_advance_q16(led_studio_transport_t *transport,
                                     uint64_t elapsed_beats_q16) {
  uint32_t transitions = 0U;

  if (transport == NULL || !transport->valid) {
    return false;
  }

  while (elapsed_beats_q16 > 0U) {
    const led_studio_cue_t *cue =
        &transport->song->cues[transport->active_cue_index];
    const led_studio_scene_t *scene =
        &transport->scenes[cue->scene_index];
    const uint32_t until_loop_end =
        scene->loop_length_q16 - transport->cue_position_q16;

    if (elapsed_beats_q16 < until_loop_end) {
      transport->cue_position_q16 += (uint32_t)elapsed_beats_q16;
      return true;
    }

    elapsed_beats_q16 -= until_loop_end;
    transport->cue_position_q16 = 0U;
    transport->completed_loops += 1U;

    if (cue->advance == LED_STUDIO_CUE_AFTER_LOOPS &&
        transport->completed_loops >= cue->loop_count) {
      if (transport->active_cue_index + 1U < transport->song->cue_count) {
        const uint16_t next_cue =
            (uint16_t)(transport->active_cue_index + 1U);
        reset_cue_position(transport, next_cue);
      } else {
        transport->final_cue_held = true;
      }
    }

    transitions += 1U;
    if (transitions > LED_STUDIO_MAX_TRANSPORT_TRANSITIONS) {
      return false;
    }
  }

  return true;
}

bool led_studio_transport_advance_us(led_studio_transport_t *transport,
                                    uint64_t elapsed_microseconds) {
  uint64_t numerator;
  uint64_t elapsed_beats_q16;

  if (transport == NULL || !transport->valid) {
    return false;
  }
  if (elapsed_microseconds == 0U) {
    return true;
  }
  if (elapsed_microseconds >
      (UINT64_MAX - transport->beat_fraction_remainder) /
          transport->song->beats_per_minute / LED_STUDIO_BEAT_ONE_Q16) {
    return false;
  }

  numerator = elapsed_microseconds * transport->song->beats_per_minute *
                  LED_STUDIO_BEAT_ONE_Q16 +
              transport->beat_fraction_remainder;
  elapsed_beats_q16 = numerator / MICROSECONDS_PER_MINUTE;
  transport->beat_fraction_remainder = numerator % MICROSECONDS_PER_MINUTE;
  return led_studio_transport_advance_q16(transport, elapsed_beats_q16);
}

const led_studio_scene_t *
led_studio_transport_current_scene(const led_studio_transport_t *transport) {
  const led_studio_cue_t *cue;

  if (transport == NULL || !transport->valid) {
    return NULL;
  }

  cue = &transport->song->cues[transport->active_cue_index];
  return &transport->scenes[cue->scene_index];
}

void led_studio_transport_render(const led_studio_transport_t *transport,
                                 led_studio_frame_t *frame) {
  const led_studio_scene_t *scene;

  if (frame == NULL) {
    return;
  }
  memset(frame, 0, sizeof(*frame));
  scene = led_studio_transport_current_scene(transport);
  if (scene != NULL) {
    memcpy(frame, scene->frame, sizeof(*frame));
  }
}

static uint8_t scale_channel(uint8_t value, uint8_t limit_percent) {
  const uint16_t scaled =
      (uint16_t)value * (uint16_t)limit_percent + (uint16_t)50U;
  return (uint8_t)(scaled / 100U);
}

void led_studio_apply_brightness_limit(const led_studio_frame_t *source,
                                       led_studio_frame_t *destination,
                                       uint8_t limit_percent) {
  size_t index;

  if (source == NULL || destination == NULL) {
    return;
  }
  if (limit_percent > 100U) {
    limit_percent = 100U;
  }

  for (index = 0U; index < LED_STUDIO_LED_COUNT; index += 1U) {
    destination->pixels[index].red =
        scale_channel(source->pixels[index].red, limit_percent);
    destination->pixels[index].green =
        scale_channel(source->pixels[index].green, limit_percent);
    destination->pixels[index].blue =
        scale_channel(source->pixels[index].blue, limit_percent);
  }
}
```
