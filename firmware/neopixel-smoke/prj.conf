## CMakeLists.txt
```
cmake_minimum_required(VERSION 3.20.0)

find_package(Zephyr REQUIRED HINTS $ENV{ZEPHYR_BASE})
project(led_studio_neopixel_smoke)

target_sources(app PRIVATE src/main.c)
```

## prj.conf
```kconfig
CONFIG_GPIO=y
CONFIG_LED_STRIP=y
CONFIG_WS2812_STRIP_GPIO=y
CONFIG_LOG=y
CONFIG_MAIN_STACK_SIZE=2048
CONFIG_BUILD_OUTPUT_UF2=y
CONFIG_USE_DT_CODE_PARTITION=y
```

## boards/xiao_ble_nrf52840.overlay
```dts
#include <zephyr/dt-bindings/gpio/gpio.h>
#include <zephyr/dt-bindings/led/led.h>

/ {
  chosen {
    zephyr,led-strip = &smoke_pixel;
  };

  smoke_pixel: ws2812 {
    compatible = "worldsemi,ws2812-gpio";
    zephyr,deferred-init;
    chain-length = <1>;
    color-mapping = <LED_COLOR_ID_RED LED_COLOR_ID_GREEN LED_COLOR_ID_BLUE>;
    gpios = <&xiao_d 0 GPIO_ACTIVE_HIGH>;
    reset-delay = <300>;
  };
};
```

## src/main.c
```c
#include <stddef.h>

#include <zephyr/device.h>
#include <zephyr/devicetree.h>
#include <zephyr/drivers/gpio.h>
#include <zephyr/drivers/led_strip.h>
#include <zephyr/kernel.h>
#include <zephyr/logging/log.h>
#include <zephyr/sys/util.h>

LOG_MODULE_REGISTER(neopixel_smoke, LOG_LEVEL_INF);

#define PIXEL_NODE DT_CHOSEN(zephyr_led_strip)
#define DIM_LEVEL 25U /* 25 / 255 = 9.8% channel duty cycle. */
#define RESET_DELAY_US DT_PROP(PIXEL_NODE, reset_delay)

BUILD_ASSERT(DT_PROP(PIXEL_NODE, chain_length) == 1,
             "This smoke test must drive exactly one pixel");
BUILD_ASSERT(DT_PROP(PIXEL_NODE, zephyr_deferred_init),
             "Set D0 low before initializing the WS2812 driver");

static const struct device *const pixel = DEVICE_DT_GET(PIXEL_NODE);
static const struct gpio_dt_spec data = GPIO_DT_SPEC_GET(PIXEL_NODE, gpios);

static const struct led_rgb sequence[] = {
    {.r = 0U, .g = 0U, .b = 0U},
    {.r = DIM_LEVEL, .g = 0U, .b = 0U},
    {.r = 0U, .g = DIM_LEVEL, .b = 0U},
    {.r = 0U, .g = 0U, .b = DIM_LEVEL},
    {.r = DIM_LEVEL, .g = DIM_LEVEL, .b = DIM_LEVEL},
};

int main(void) {
  int ret;

  if (!gpio_is_ready_dt(&data)) {
    LOG_ERR("D0 GPIO device is not ready");
    return 0;
  }

  /* Preload the physical output low while enabling it, before driver init. */
  ret = gpio_pin_configure_dt(&data, GPIO_OUTPUT_LOW);
  if (ret != 0) {
    LOG_ERR("Could not initialize D0 low: %d", ret);
    return 0;
  }
  k_busy_wait(RESET_DELAY_US);

  ret = device_init(pixel);
  if (ret != 0 || !device_is_ready(pixel)) {
    LOG_ERR("WS2812 initialization failed: %d", ret);
    return 0;
  }

  LOG_INF("One RGB pixel on D0: off, red, green, blue, white at 25/255");
  while (true) {
    for (size_t i = 0U; i < ARRAY_SIZE(sequence); i += 1U) {
      /* The GPIO driver may rewrite this buffer into wire order in place. */
      struct led_rgb frame = sequence[i];

      ret = led_strip_update_rgb(pixel, &frame, 1U);
      if (ret != 0) {
        (void)gpio_pin_set_raw(data.port, data.pin, 0);
        LOG_ERR("Pixel update failed; holding D0 low: %d", ret);
        return 0;
      }
      /* This GPIO driver leaves the wire low but does not wait for reset. */
      k_busy_wait(RESET_DELAY_US);
      k_sleep(K_SECONDS(1));
    }
  }
}
```
